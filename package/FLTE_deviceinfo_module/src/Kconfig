## package/FLTE_deviceinfo_module/src/Kconfig
```kconfig
config FLTE_deviceinfo_module
	tristate "FLTE device information Module"
	help
	  Module for giving the FLTE device information.
```

## package/FLTE_gpio_driver/src/Kconfig
```kconfig
config FLTE_gpio_driver
	tristate "FLTE gpio driver"
	help
	  This is a GPIO driver to register control the gpio lines.
```

## package/FLTE_gpio_i2c_driver/src/Kconfig
```kconfig
config FLTE_gpio_i2c_driver
	tristate "Custom GPIO-based I2C driver"
	help
	  This is an I2C driver to register 1 to 4 custom I2C buses using
	  GPIO lines.

	  This support is also available as a module.  If so, the module
	  will be called i2c-gpio-custom.
```

## package/FLTE_led_driver/src/Kconfig
```kconfig
config FLTE_led_driver
	tristate "FLTE Led driver"
	help
	  This is an I2C driver to register 1 to 4 custom I2C buses using
	  GPIO lines.

	  This support is also available as a module.  If so, the module
	  will be called i2c-gpio-custom.
```

## package/feeds/ltq_dsl_cpe/ifx-dsl-cpe-api-danube/Config.in
```kconfig
menu "Configuration"
	depends on PACKAGE_ifx-dsl-cpe-api-danube

	choice
		prompt "build model"
		default ifx-dsl-cpe-api-danube_MODEL_FOOTPRINT
		help
		  Selection of a model (predefined combination of configure options).

	config ifx-dsl-cpe-api-danube_MODEL_LITE
		bool "Lite"
		help
		  Minimum features included.
		  This model should ONLY demonstrate the minimum possible size.

	config ifx-dsl-cpe-api-danube_MODEL_FOOTPRINT
		bool "Footprint"
		help
		  Defined for low footprint applications.

	config ifx-dsl-cpe-api-danube_MODEL_TYPICAL
		bool "Typical"
		help
		  Defined for most typical use.

	config ifx-dsl-cpe-api-danube_MODEL_FULL
		bool "Full"
		help
		  Includes all features but NOT all debug functionalities.

	config ifx-dsl-cpe-api-danube_MODEL_DEBUG
		bool "Debug"
		help
		  Includes all features AND debug functionalities.
	endchoice

	menu "optional build options"
		depends on PACKAGE_ifx-dsl-cpe-api-danube
	config ifx-dsl-cpe-api-danube_USE_ADDITIONAL_BUILD_OPTIONS
		depends on PACKAGE_ifx-dsl-cpe-api-danube
		bool "Use additional build options"
		default n
		help
		  Provides the possibility to include/exclude single features directly.
		  This configuration overwrites selections which are done by the "build model" configuration.

	config ifx-dsl-cpe-api-danube_ADDITIONAL_BUILD_OPTIONS
		depends on ifx-dsl-cpe-api-danube_USE_ADDITIONAL_BUILD_OPTIONS
		string "Additional build options"
		help
		  Defines to include/exclude single feature using available configure options.
		  Please refer to the documentation of the DSL CPE API "Configure options for the DSL CPE API"
	endmenu
endmenu
```

## package/feeds/ltq_dsl_cpe/ifx-dsl-cpe-api-vrx/Config.in
```kconfig
menu "Configuration"
	depends on PACKAGE_ifx-dsl-cpe-api-vrx

	choice
		prompt "Device selection"
		default ifx-dsl-cpe-api-vrx_DEVICE_VR9
		help
		  Selection of a device.

	config ifx-dsl-cpe-api-vrx_DEVICE_VR9
		bool "VRX200"
		help
		  Actiavtes build for VRX200 Family.

	config ifx-dsl-cpe-api-vrx_DEVICE_VR10
		bool "VRX300"
		help
		  Actiavtes build for VRX300 Family.
	endchoice

	choice
		prompt "build model"
		default ifx-dsl-cpe-api-vrx_MODEL_FULL
		help
		  Selection of a model (predefined combination of configure options).

	config ifx-dsl-cpe-api-vrx_MODEL_LITE
		bool "Lite"
		help
		  Minimum features included.
		  This model should ONLY demonstrate the minimum possible size.

	config ifx-dsl-cpe-api-vrx_MODEL_FOOTPRINT
		bool "Footprint"
		help
		  Defined for low footprint applications.

	config ifx-dsl-cpe-api-vrx_MODEL_TYPICAL
		bool "Typical"
		help
		  Defined for most typical use.

	config ifx-dsl-cpe-api-vrx_MODEL_FULL
		bool "Full"
		help
		  Includes all features but NOT all debug functionalities.

	config ifx-dsl-cpe-api-vrx_MODEL_DEBUG
		bool "Debug"
		help
		  Includes all features AND debug functionalities.
	endchoice

	menu "optional build options"
		depends on PACKAGE_ifx-dsl-cpe-api-vrx
	config ifx-dsl-cpe-api-vrx_USE_ADDITIONAL_BUILD_OPTIONS
		depends on PACKAGE_ifx-dsl-cpe-api-vrx
		bool "Use additional build options"
		default n
		help
		  Provides the possibility to include/exclude single features directly.
		  This configuration overwrites selections which are done by the "build model" configuration.

	config ifx-dsl-cpe-api-vrx_ADDITIONAL_BUILD_OPTIONS
		depends on ifx-dsl-cpe-api-vrx_USE_ADDITIONAL_BUILD_OPTIONS
		string "Additional build options"
		help
		  Defines to include/exclude single feature using available configure options.
		  Please refer to the documentation of the DSL CPE API "Configure options for the DSL CPE API"
	endmenu
endmenu
```

## package/feeds/ltq_dsl_cpe/ifx-dsl-cpe-mei-danube/Config.in
```kconfig
menu "Configuration"
	depends on PACKAGE_ifx-dsl-cpe-mei-danube

	choice
		prompt "build model"
		default ifx-dsl-cpe-mei-danube_MODEL_DEFAULT
		help
		  Selection of a model (predefined combination of configure options).

	config ifx-dsl-cpe-mei-danube_MODEL_DEFAULT
		bool "Default"
		help
		  Default features included, no debug support.

	config ifx-dsl-cpe-mei-danube_MODEL_DEBUG
		bool "Debug"
		help
		  Defined to enable debug support within the driver.
	endchoice

	menu "optional build options"
		depends on PACKAGE_ifx-dsl-cpe-mei-danube
	config ifx-dsl-cpe-mei-danube_USE_ADDITIONAL_BUILD_OPTIONS
		depends on PACKAGE_ifx-dsl-cpe-mei-danube
		bool "Use additional build options"
		default n
		help
		  Provides the possibility to include/exclude single features directly.
		  This configuration overwrites selections which are done by the "build model" configuration.

	config ifx-dsl-cpe-mei-danube_ADDITIONAL_BUILD_OPTIONS
		depends on ifx-dsl-cpe-mei-danube_USE_ADDITIONAL_BUILD_OPTIONS
		string "Additional build options"
		help
		  Defines to include/exclude single feature using available configure options.
	endmenu
endmenu
```

## package/feeds/ltq_dsl_cpe/ifx-dsl-cpe-mei-vrx/Config.in
```kconfig
menu "Configuration"
	depends on PACKAGE_ifx-dsl-cpe-mei-vrx

	choice
		prompt "Device selection"
		default ifx-dsl-cpe-mei-vrx_DEVICE_VR9
		help
		  Selection of a device.

	config ifx-dsl-cpe-mei-vrx_DEVICE_VR9
		bool "VRX200"
		help
		  Actiavtes build for VRX200 Family.

	config ifx-dsl-cpe-mei-vrx_DEVICE_VR10
		bool "VRX300"
		help
		  Actiavtes build for VRX300 Family.
	endchoice

	config IFX_VRX_MAX_DEVICE
		string
		prompt "Max. number of devices"
		default "1"
		help
		  Defines the max. number of VRX devices used.
		  Set it to 2 for activating OFF-chip bonding.

	config IFX_VRX_LINES_PER_DEVICE
		string
		prompt "Lines per device"
		default "1"
		help
		  Defines the number of lines used per VRX devices.
		  Set it to 2 for activating ON-chip bonding.
	
        config ifx-dsl-cpe-mei-vrx_USE_KERNEL_BUILD_IN
                bool "Use kernel build-in"
                default n

        config ifx-dsl-cpe-mei-vrx_USE_PCI_SLAVE_DOWNLOAD
                bool "Use PCI Slave firmware download"
                default n

	choice
		depends on ifx-dsl-cpe-mei-vrx_USE_PCI_SLAVE_DOWNLOAD
		prompt "PCI Slave address range"
		default ifx-dsl-cpe-mei-vrx_USE_PCI_SLAVE_ADDR_RANGE_ADTRAN
	config ifx-dsl-cpe-mei-vrx_USE_PCI_SLAVE_ADDR_RANGE_ADTRAN
		bool "ADTRAN"
	config ifx-dsl-cpe-mei-vrx_USE_PCI_SLAVE_ADDR_RANGE_BONDING
		bool "BONDING"
    	endchoice
endmenu
```

## package/feeds/ltq_feeds_ethsw/ifx-ethsw/config/Config.in
```kconfig
config FEATURE_IFX_GPHY_WEB_GUI
	bool 'GPHY WEB GUI'
	help
	  GPHY Web GUI interface for debug supported
```
